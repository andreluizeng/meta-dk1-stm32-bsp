## conf/layer.conf
```bitbake
# We have a conf and classes directory, add to BBPATH
BBPATH .= ":${LAYERDIR}"

# We have a packages directory, add to BBFILES
BBFILES += "${LAYERDIR}/recipes-*/*/*.bb"
BBFILES += "${LAYERDIR}/recipes-*/*/*.bbappend"

BBFILE_COLLECTIONS += "stm32dk1bsp"
BBFILE_PATTERN_stm32dk1bsp = "^${LAYERDIR}/"
BBFILE_PRIORITY_cstm32dk1bsp = "5"

LAYERDEPENDS_stm32dk1bsp = "core mainlinecommon-layer"
LAYERSERIES_COMPAT_stm32dk1bsp = "dunfell kirkstone"
```

## scripts/lib/wic/canned-wks/sdimage-stm32mp1-custom-partitions.wks
```
# short-description: Create STM32MP1 SD card image with a boot partition
# long-description: Creates a partitioned SD card image. Boot files
# are located in the first ext4 partition.

part fsbl1 --source rawcopy --sourceparams="file=u-boot-spl.stm32" --part-name "fsbl1" --ondisk mmcblk --align 1 --size 256k
part fsbl2 --source rawcopy --sourceparams="file=u-boot-spl.stm32" --part-name "fsbl2" --ondisk mmcblk --align 1 --size 256k
part ssbl --source rawcopy --sourceparams="file=u-boot.img" --part-name "ssbl" --ondisk mmcblk --align 1 --size 2M
# part / --source rootfs --ondisk mmcblk0 --fstype=ext4 --label root --part-name "rootfs" --align 4096 --use-uuid --active --fixed-size 8G
# part / --ondisk mmcblk1 --fstype=ext4 --label user --part-name "userdata" --align 4096 --use-uuid --active --fixed-size 32G
# part / --ondisk mmcblk2 --fstype=ext4 --label root2 --part-name "rootfs2" --align 4096 --use-uuid --active --fixed-size 8G

bootloader --ptable gpt
```
